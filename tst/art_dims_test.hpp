#pragma once
// Host dims-drift suite for the code-authored overlay/effect sheets (bead
// monhun-ardu-42n.2). src/generated/art_dims.hpp is emitted by tools/gen-art.py
// from tools/fxdump.cpp, which reads the same src/core/game.hpp tables the sim
// uses: these tests re-derive every hw/hh/reach from the core accessors, so a
// tuning change in game.hpp fails make test until `make gen` regenerates the
// header AND the sheets.
//
// The sheet presence tests parse fxdata/blocks/Sprites.txt (generated by
// tools/convert-sprite.py from the PNGs) and check that each declared hit box
// really has painted (mask=1) pixels at the exact frame rect the blobs claim.
// That is the host end of the pixel-exactness chain: core dims -> fxdump JSON
// -> gen-art.py PNG -> convert-sprite blob.
#include "test.hpp"
#include "../src/core/game.hpp"
#include "../src/generated/art_dims.hpp"

#include <stdio.h>
#include <string>

using namespace mh;

namespace artdimstest {

const char *const BLOCK_SHEETS = "fxdata/blocks/Sprites.txt";

// ------------------------------------------------------------ blob parsing

// Find `uint8_t <sym>[] = {` and decode the decimal bytes up to `};`.
bool readBlob(const std::string &sym, std::vector<int> &out, std::string &err) {
    FILE *f = fopen(BLOCK_SHEETS, "rb");
    if (f == nullptr) {
        err = std::string("cannot open ") + BLOCK_SHEETS;
        return false;
    }
    std::string text;
    char buf[4096];
    size_t n;
    while ((n = fread(buf, 1, sizeof(buf), f)) > 0)
        text.append(buf, n);
    fclose(f);

    const std::string decl = "uint8_t " + sym + "[] =";
    const size_t at = text.find(decl);
    if (at == std::string::npos) {
        err = sym + ": declaration not found";
        return false;
    }
    const size_t open = text.find('{', at);
    const size_t close = text.find('}', open);
    if (open == std::string::npos || close == std::string::npos) {
        err = sym + ": malformed declaration";
        return false;
    }
    out.clear();
    size_t i = open + 1;
    while (i < close) {
        while (i < close && (text[i] == ' ' || text[i] == '\n' || text[i] == '\r' || text[i] == '\t' || text[i] == ','))
            i++;
        if (i >= close)
            break;
        int v = 0;
        while (i < close && text[i] >= '0' && text[i] <= '9') {
            v = v * 10 + (text[i] - '0');
            i++;
        }
        out.push_back(v);
    }
    return true;
}

// A plus-mask sheet blob: 2-byte w/h header then per frame, per shade pass,
// per 8-px page, per column a (data, mask) pair.
struct Blob {
    int w = 0, h = 0, frames = 0;
    std::vector<int> bytes;
};

bool parseBlob(const char *sym, Blob &out, Test &t) {
    std::vector<int> raw;
    std::string err;
    if (!readBlob(sym, raw, err) || raw.size() < 2) {
        t.assert(1, 0, err.empty() ? std::string(sym) + ": empty blob" : err);
        return false;
    }
    out.w = raw[0];
    out.h = raw[1];
    out.bytes.assign(raw.begin() + 2, raw.end());
    const int frame_bytes = ((out.h + 7) / 8) * out.w * 3 * 2;
    out.frames = frame_bytes > 0 ? static_cast<int>(out.bytes.size()) / frame_bytes : 0;
    return true;
}

// bit of a page byte: pixel y has bit y&7; normalized to 1/0 so the suite's
// assert() can compare directly.
inline int bitAt(int y, int value) {
    return (value >> (y & 7)) & 1;
}

// convert-sprite.py layout: per frame, 3 shade passes; each pass is
// page_count * w (data, mask) pairs in column-then-page order. The stored
// masks are the per-plane AND complements (mask=1 with data=0 is an eraser).
int pixelData(const Blob &b, int frame, int shade, int x, int page) {
    const int page_count = (b.h + 7) / 8;
    return b.bytes[((frame * 3 + shade) * page_count + page) * b.w * 2 + x * 2];
}
int pixelMask(const Blob &b, int frame, int shade, int x, int page) {
    const int page_count = (b.h + 7) / 8;
    return b.bytes[((frame * 3 + shade) * page_count + page) * b.w * 2 + x * 2 + 1];
}

// ------------------------------------------------------- small helpers

int16_t coreHw(const Attack *a) {
    return attackHw(a);
}
int16_t coreHh(const Attack *a) {
    return attackHh(a);
}
int16_t coreReach(const Attack *a) {
    return attackReach(a);
}
int16_t monHw(const MonsterAttack *a) {
    return monsterAttackHw(a);
}
int16_t monHh(const MonsterAttack *a) {
    return monsterAttackHh(a);
}

// ----------------------------------------------------------- dims vs core

// Branch attacks are drawn through the same overlay path as the main attacks
// (sword step-slash / spin-cut in particular), so their boxes must be dumped
// and pinned too.
void assertBranchDims(Test &t, const WeaponDef *w, const char *what) {
    t.assert(art_dims::sword_branch0_hw, coreHw(branchAtk(weaponBranch(w, 0))), "sword branch0 hw");
    t.assert(art_dims::sword_branch0_hh, coreHh(branchAtk(weaponBranch(w, 0))), "sword branch0 hh");
    t.assert(art_dims::sword_branch0_reach, coreReach(branchAtk(weaponBranch(w, 0))), "sword branch0 reach");
    t.assert(art_dims::sword_branch1_hw, coreHw(branchAtk(weaponBranch(w, 1))), "sword branch1 hw");
    t.assert(art_dims::sword_branch1_hh, coreHh(branchAtk(weaponBranch(w, 1))), "sword branch1 hh");
    t.assert(art_dims::sword_branch1_reach, coreReach(branchAtk(weaponBranch(w, 1))), "sword branch1 reach");
    (void)what;
}

void testCoreDimMirrors(Test &t) {
    std::cout << "---------- art dims match core accessors ----------" << std::endl;
    const WeaponDef *w = &WEAPON_DEFS[0];
    t.assert(art_dims::sword_atk0_hw, coreHw(weaponAttack(w, 0)), "sword atk0 hw");
    t.assert(art_dims::sword_atk0_hh, coreHh(weaponAttack(w, 0)), "sword atk0 hh");
    t.assert(art_dims::sword_atk0_reach, coreReach(weaponAttack(w, 0)), "sword atk0 reach");
    t.assert(art_dims::sword_atk1_hw, coreHw(weaponAttack(w, 1)), "sword atk1 hw");
    t.assert(art_dims::sword_atk1_hh, coreHh(weaponAttack(w, 1)), "sword atk1 hh");
    t.assert(art_dims::sword_atk1_reach, coreReach(weaponAttack(w, 1)), "sword atk1 reach");
    t.assert(art_dims::sword_atk2_hw, coreHw(weaponAttack(w, 2)), "sword atk2 hw");
    t.assert(art_dims::sword_atk2_hh, coreHh(weaponAttack(w, 2)), "sword atk2 hh");
    t.assert(art_dims::sword_atk2_reach, coreReach(weaponAttack(w, 2)), "sword atk2 reach");
    t.assert(art_dims::sword_special_hw, coreHw(weaponSpecial(w)), "sword special hw");
    t.assert(art_dims::sword_special_hh, coreHh(weaponSpecial(w)), "sword special hh");
    t.assert(art_dims::sword_special_reach, coreReach(weaponSpecial(w)), "sword special reach");
    assertBranchDims(t, w, "sword");

    w = &WEAPON_DEFS[1];
    t.assert(art_dims::flail_atk0_hw, coreHw(weaponAttack(w, 0)), "flail atk0 hw");
    t.assert(art_dims::flail_atk0_hh, coreHh(weaponAttack(w, 0)), "flail atk0 hh");
    t.assert(art_dims::flail_atk0_reach, coreReach(weaponAttack(w, 0)), "flail atk0 reach");
    t.assert(art_dims::flail_atk1_hw, coreHw(weaponAttack(w, 1)), "flail atk1 hw");
    t.assert(art_dims::flail_atk1_hh, coreHh(weaponAttack(w, 1)), "flail atk1 hh");
    t.assert(art_dims::flail_atk1_reach, coreReach(weaponAttack(w, 1)), "flail atk1 reach");
    t.assert(art_dims::flail_atk2_hw, coreHw(weaponAttack(w, 2)), "flail atk2 hw");
    t.assert(art_dims::flail_atk2_hh, coreHh(weaponAttack(w, 2)), "flail atk2 hh");
    t.assert(art_dims::flail_atk2_reach, coreReach(weaponAttack(w, 2)), "flail atk2 reach");
    t.assert(art_dims::flail_special_hw, coreHw(weaponSpecial(w)), "flail special hw");
    t.assert(art_dims::flail_special_hh, coreHh(weaponSpecial(w)), "flail special hh");
    t.assert(art_dims::flail_special_reach, coreReach(weaponSpecial(w)), "flail special reach");

    w = &WEAPON_DEFS[2];
    t.assert(art_dims::gunshield_atk0_hw, coreHw(weaponAttack(w, 0)), "gun atk0 hw");
    t.assert(art_dims::gunshield_atk0_hh, coreHh(weaponAttack(w, 0)), "gun atk0 hh");
    t.assert(art_dims::gunshield_atk0_reach, coreReach(weaponAttack(w, 0)), "gun atk0 reach");
    t.assert(art_dims::gunshield_atk1_hw, coreHw(weaponAttack(w, 1)), "gun atk1 hw");
    t.assert(art_dims::gunshield_atk1_hh, coreHh(weaponAttack(w, 1)), "gun atk1 hh");
    t.assert(art_dims::gunshield_atk1_reach, coreReach(weaponAttack(w, 1)), "gun atk1 reach");
    t.assert(art_dims::gunshield_atk2_hw, coreHw(weaponAttack(w, 2)), "gun atk2 hw");
    t.assert(art_dims::gunshield_atk2_hh, coreHh(weaponAttack(w, 2)), "gun atk2 hh");
    t.assert(art_dims::gunshield_atk2_reach, coreReach(weaponAttack(w, 2)), "gun atk2 reach");

    const MonsterAttack *ma = &MONSTER_ATTACKS[0];
    t.assert(art_dims::monster_lunge_hw, monsterAttackHw(ma), "lunge hw");
    t.assert(art_dims::monster_lunge_hh, monsterAttackHh(ma), "lunge hh");
    t.assert(art_dims::monster_lunge_reach, monsterAttackReach(ma), "lunge reach");
    ma = &MONSTER_ATTACKS[1];
    t.assert(art_dims::monster_sweep_hw, monsterAttackHw(ma), "sweep hw");
    t.assert(art_dims::monster_sweep_hh, monsterAttackHh(ma), "sweep hh");
    t.assert(art_dims::monster_sweep_reach, monsterAttackReach(ma), "sweep reach");
}

// -------------------------------------- slash frame layout carries core dims

// The slash frame is 32x32 with the hit box centred and the white 4x4 core on
// the box centre (slash_core_x/y). One frame per distinct sword box, in the
// order the generator authors them.
void testSlashLayout(Test &t) {
    const WeaponDef *w = &WEAPON_DEFS[0];
    const int16_t boxes[5][2] = {
        {coreHw(weaponAttack(w, 0)), coreHh(weaponAttack(w, 0))},
        {coreHw(weaponAttack(w, 2)), coreHh(weaponAttack(w, 2))},
        {coreHw(weaponSpecial(w)), coreHh(weaponSpecial(w))},
        {coreHw(branchAtk(weaponBranch(w, 0))), coreHh(branchAtk(weaponBranch(w, 0)))},
        {coreHw(branchAtk(weaponBranch(w, 1))), coreHh(branchAtk(weaponBranch(w, 1)))},
    };
    for (int i = 0; i < 5; i++) {
        const int x = (art_dims::slash_frame_w - boxes[i][0]) / 2;
        const int y = (art_dims::slash_frame_h - boxes[i][1]) / 2;
        t.assertGreaterThan(x, -1, "slash box x fits");
        t.assertGreaterThan(art_dims::slash_frame_w - (x + boxes[i][0]), -1, "slash box right fits");
        t.assertGreaterThan(y, -1, "slash box y fits");
        t.assertGreaterThan(art_dims::slash_frame_h - (y + boxes[i][1]), -1, "slash box bottom fits");
        t.assert((art_dims::slash_frame_h - boxes[i][1]) % 2, 0, "slash box y centred");
        t.assert((art_dims::slash_frame_w - boxes[i][0]) % 2, 0, "slash box x centred");
        // core centre == box centre == frame centre
        t.assert(x + boxes[i][0] / 2, art_dims::slash_frame_w / 2, "slash box centre x");
        t.assert(y + boxes[i][1] / 2, art_dims::slash_frame_h / 2, "slash box centre y");
        t.assert(art_dims::slash_core_x + art_dims::slash_core_size / 2, art_dims::slash_frame_w / 2, "slash core centre x");
        t.assert(art_dims::slash_core_y + art_dims::slash_core_size / 2, art_dims::slash_frame_h / 2, "slash core centre y");
    }
    // Frame order: combo 12x10, combo 18x14, special 20x16, step-slash 14x12,
    // spin-cut 28x26.
    t.assert(art_dims::sword_atk0_hw, boxes[0][0], "slash f0 box w");
    t.assert(art_dims::sword_atk2_hw, boxes[1][0], "slash f1 box w");
    t.assert(art_dims::sword_special_hw, boxes[2][0], "slash f2 box w");
    t.assert(art_dims::sword_branch0_hw, boxes[3][0], "slash f3 box w");
    t.assert(art_dims::sword_branch1_hw, boxes[4][0], "slash f4 box w");
    t.assert(art_dims::sword_branch1_hh, boxes[4][1], "slash f4 box h");
}

// --------------------------------------------- per-sheet pixel presence

void testSheetPixels(Test &t) {
    Blob slash, ripspecial, parry, whirl, deflect, guard, reload, erase, trail, chip, tail;
    if (!parseBlob("fxslash", slash, t) || !parseBlob("fxripspecial", ripspecial, t) || !parseBlob("fxparry", parry, t) || !parseBlob("fxwhirl", whirl, t) || !parseBlob("fxdeflect", deflect, t) ||
        !parseBlob("fxguard", guard, t) || !parseBlob("fxreload", reload, t) || !parseBlob("fxerase", erase, t) || !parseBlob("fxtrail", trail, t) || !parseBlob("fxchip", chip, t) ||
        !parseBlob("fxtail", tail, t))
        return;

    // Sheet headers agree with the generated frame layout.
    t.assert(slash.w, art_dims::slash_frame_w, "slash blob frame w");
    t.assert(slash.h, art_dims::slash_frame_h, "slash blob frame h");
    t.assert(slash.frames, art_dims::slash_frames, "slash blob frames");
    t.assert(parry.w, art_dims::parry_frame_w, "parry blob frame w");
    t.assert(parry.h, art_dims::parry_frame_h, "parry blob frame h");
    t.assert(guard.w, art_dims::guard_frame_w, "guard blob frame w");
    t.assert(guard.frames, art_dims::guard_frames, "guard blob frames");
    t.assert(whirl.frames, art_dims::whirl_frames, "whirl blob frames");
    t.assert(chip.frames, art_dims::chip_frames, "chip blob frames");
    t.assert(tail.w, art_dims::tail_frame_w, "tail blob frame w");
    t.assert(tail.h, art_dims::tail_frame_h, "tail blob frame h");
    t.assert(tail.frames, art_dims::tail_frames, "tail blob frames");

    // Sword slash frames 0..4: light box (hw x hh) centred in the 32x32 frame
    // with the white 4x4 core on the box centre. Frame order: combo 12x10,
    // combo 18x14, special 20x16, step-slash 14x12, spin-cut 28x26.
    const WeaponDef *sword = &WEAPON_DEFS[0];
    const int16_t boxes[5][2] = {
        {coreHw(weaponAttack(sword, 0)), coreHh(weaponAttack(sword, 0))},
        {coreHw(weaponAttack(sword, 2)), coreHh(weaponAttack(sword, 2))},
        {coreHw(weaponSpecial(sword)), coreHh(weaponSpecial(sword))},
        {coreHw(branchAtk(weaponBranch(sword, 0))), coreHh(branchAtk(weaponBranch(sword, 0)))},
        {coreHw(branchAtk(weaponBranch(sword, 1))), coreHh(branchAtk(weaponBranch(sword, 1)))},
    };
    for (int i = 0; i < 5; i++) {
        const int px = (slash.w - boxes[i][0]) / 2;
        const int py = (slash.h - boxes[i][1]) / 2;
        // box top-left pixel: plane0 on, plane1 on, plane2 off (light gray)
        t.assert(bitAt(py % 8, pixelMask(slash, i, 0, px, py / 8)), 1, "slash box mask");
        t.assert(bitAt(py % 8, pixelData(slash, i, 0, px, py / 8)), 1, "slash box plane0 on");
        t.assert(bitAt(py % 8, pixelData(slash, i, 1, px, py / 8)), 1, "slash box plane1 on");
        t.assert(bitAt(py % 8, pixelData(slash, i, 2, px, py / 8)), 0, "slash box plane2 off");
        // white core at the box/frame centre: all planes on
        t.assert(bitAt(art_dims::slash_core_y % 8, pixelData(slash, i, 0, art_dims::slash_core_x, art_dims::slash_core_y / 8)), 1, "slash core plane0");
        t.assert(bitAt(art_dims::slash_core_y % 8, pixelData(slash, i, 2, art_dims::slash_core_x, art_dims::slash_core_y / 8)), 1, "slash core plane2");
        // outside the box (one px left) stays transparent
        t.assert(bitAt(py % 8, pixelMask(slash, i, 0, px - 1, py / 8)), 0, "slash outside box clear");
    }
    // Riposte rim matches the special box + 2 px per side.
    {
        const int rhw = boxes[2][0] + 2 * art_dims::slash_riposte_pad;
        const int rhh = boxes[2][1] + 2 * art_dims::slash_riposte_pad;
        const int rx = (ripspecial.w - rhw) / 2;
        const int ry = (ripspecial.h - rhh) / 2;
        t.assert(bitAt(ry % 8, pixelMask(ripspecial, 0, 0, rx, ry / 8)), 1, "riposte rim mask");
        t.assert(bitAt(ry % 8, pixelData(ripspecial, 0, 1, rx, ry / 8)), 1, "riposte rim light");
        t.assert(bitAt(ry % 8, pixelData(ripspecial, 0, 2, rx, ry / 8)), 0, "riposte rim no white");
    }

    // Parry: white blade bar 2x14 at frame x=11, light-gray cap 6x2 at x=9,y=2.
    t.assert(bitAt(4 % 8, pixelData(parry, 0, 0, 12, 4 / 8)), 1, "parry blade plane0");
    t.assert(bitAt(4 % 8, pixelData(parry, 0, 2, 12, 4 / 8)), 1, "parry blade plane2");
    t.assert(bitAt(2 % 8, pixelData(parry, 0, 1, 10, 2 / 8)), 1, "parry cap plane1");

    // Whirl: frame 0 is a 2x2 light orbit dot, frame 1 a 4x4 white ball,
    // frame 2 a 1x1 light chain dot, frame 3 a 2x2 white stun sparkle.
    t.assert(bitAt(0, pixelData(whirl, art_dims::whirl_dot_frame, 0, 0, 0)), 1, "whirl dot plane0");
    t.assert(bitAt(1, pixelData(whirl, art_dims::whirl_ball_frame, 2, 1, 0)), 1, "whirl ball plane2");
    t.assert(bitAt(0, pixelData(whirl, art_dims::whirl_chain_frame, 0, 0, 0)), 1, "whirl chain dot plane0");
    t.assert(bitAt(0, pixelData(whirl, art_dims::whirl_chain_frame, 1, 0, 0)), 1, "whirl chain dot plane1");
    t.assert(bitAt(0, pixelData(whirl, art_dims::whirl_chain_frame, 2, 0, 0)), 0, "whirl chain dot plane2 off");
    t.assert(bitAt(0, pixelMask(whirl, art_dims::whirl_chain_frame, 0, 1, 0)), 0, "whirl chain dot 1px");
    t.assert(bitAt(0, pixelData(whirl, art_dims::whirl_stun_frame, 2, 0, 0)), 1, "whirl stun plane2");
    t.assert(bitAt(1, pixelData(whirl, art_dims::whirl_stun_frame, 2, 1, 0)), 1, "whirl stun plane2 row1");
    t.assert(bitAt(0, pixelMask(whirl, art_dims::whirl_stun_frame, 0, 2, 0)), 0, "whirl stun 2px wide");
    // Deflect: two light-gray 1x12 bars at the player's left/right edge.
    t.assert(bitAt(2 % 8, pixelData(deflect, 0, 0, 2, 2 / 8)), 1, "deflect left bar plane0");
    t.assert(bitAt(2 % 8, pixelData(deflect, 0, 0, 21, 2 / 8)), 1, "deflect right bar plane0");

    // Gun shield: light plate with a black eraser notch (mask on, all planes
    // off), white guard variant, shove variant one px further out.
    t.assert(bitAt(1 % 8, pixelMask(guard, 0, 0, 5, 1 / 8)), 1, "guard notch mask");
    t.assert(bitAt(1 % 8, pixelData(guard, 0, 0, 5, 1 / 8)), 0, "guard notch plane0 off");
    t.assert(bitAt(1 % 8, pixelData(guard, 0, 1, 5, 1 / 8)), 0, "guard notch plane1 off");
    t.assert(bitAt(1 % 8, pixelData(guard, 0, 0, 2, 1 / 8)), 1, "guard plate plane0");
    t.assert(bitAt(1 % 8, pixelData(guard, 1, 2, 2, 1 / 8)), 1, "guard variant white");
    t.assert(bitAt(1 % 8, pixelData(guard, 2, 2, 1, 1 / 8)), 1, "shove plate white");
    // Reload bar: light 1 px row at frame y=3 (mock x+3, y-3, 10x2).
    t.assert(bitAt(3 % 8, pixelData(reload, 0, 0, 0, 3 / 8)), 1, "reload bar plane0");
    t.assert(bitAt(0, pixelMask(reload, 0, 0, 0, 0)), 0, "reload above bar clear");

    // I-frame erase: 4x1 black eraser (mask on, planes off) and nothing else.
    t.assert(bitAt(0, pixelMask(erase, 0, 0, 0, 0)), 1, "erase mask on");
    t.assert(bitAt(0, pixelData(erase, 0, 0, 0, 0)), 0, "erase plane0 off");
    t.assert(bitAt(0, pixelMask(erase, 0, 0, 0, 1)), 0, "erase below row clear");

    // Trail puffs: frame 0 light gray, frame 1 dark gray.
    t.assert(bitAt(0, pixelData(trail, 0, 0, 0, 0)), 1, "trail puff light plane0");
    t.assert(bitAt(0, pixelData(trail, 1, 0, 0, 0)), 1, "trail puff dark plane0");
    t.assert(bitAt(0, pixelData(trail, 1, 1, 0, 0)), 0, "trail puff dark plane1 off");

    // Chip: 3x3 white idle/aim chip (frame 0) and 4x4 white ball (frame 1).
    t.assert(bitAt(0, pixelData(chip, art_dims::chip_idle_frame, 2, 0, 0)), 1, "chip idle white");
    t.assert(bitAt(0, pixelData(chip, art_dims::chip_idle_frame, 2, 1, 0)), 1, "chip idle row0 col1");
    t.assert(bitAt(0, pixelMask(chip, art_dims::chip_idle_frame, 0, 3, 0)), 0, "chip idle 3px wide");
    t.assert(bitAt(0, pixelData(chip, art_dims::chip_ball_frame, 2, 1, 0)), 1, "chip ball white");
    t.assert(chip.w, art_dims::chip_frame_w, "chip blob frame w");

    // Breakable-part tail: frames in combatPartArtFrame() order (east intact,
    // east broken, west intact, west broken). Intact frames are a light body
    // (planes 0+1) with a white tip (plane 2); broken frames are a dark stub
    // (plane 0 only) at the body end; the far side stays transparent.
    t.assert(bitAt(2 % 8, pixelMask(tail, 0, 0, 0, 2 / 8)), 1, "tail east intact mask");
    t.assert(bitAt(2 % 8, pixelData(tail, 0, 0, 0, 2 / 8)), 1, "tail east intact plane0");
    t.assert(bitAt(2 % 8, pixelData(tail, 0, 1, 0, 2 / 8)), 1, "tail east intact plane1");
    t.assert(bitAt(2 % 8, pixelData(tail, 0, 2, 0, 2 / 8)), 0, "tail east intact tip is light");
    t.assert(bitAt(3 % 8, pixelData(tail, 0, 2, 0, 3 / 8)), 1, "tail east white tip plane2");
    t.assert(bitAt(2 % 8, pixelMask(tail, 0, 0, 12, 2 / 8)), 0, "tail east far side clear");
    t.assert(bitAt(3 % 8, pixelData(tail, 1, 0, 9, 3 / 8)), 1, "tail east broken stub plane0");
    t.assert(bitAt(3 % 8, pixelData(tail, 1, 1, 9, 3 / 8)), 0, "tail east broken stub dark only");
    t.assert(bitAt(2 % 8, pixelMask(tail, 1, 0, 0, 2 / 8)), 0, "tail east broken clears the tip");
    t.assert(bitAt(2 % 8, pixelData(tail, 2, 0, 6, 2 / 8)), 1, "tail west intact plane0");
    t.assert(bitAt(3 % 8, pixelData(tail, 2, 2, 15, 3 / 8)), 1, "tail west white tip plane2");
    t.assert(bitAt(2 % 8, pixelMask(tail, 2, 0, 0, 2 / 8)), 0, "tail west near side clear");
    t.assert(bitAt(3 % 8, pixelData(tail, 3, 0, 0, 3 / 8)), 1, "tail west broken stub plane0");
    t.assert(bitAt(3 % 8, pixelData(tail, 3, 1, 0, 3 / 8)), 0, "tail west broken stub dark only");
    t.assert(bitAt(3 % 8, pixelMask(tail, 3, 0, 9, 3 / 8)), 0, "tail west broken clears the tip");

    // Frame coverage: every declared frame of every new sheet is parsed, so a
    // truncated Sprites.txt (stale append) cannot silently skip an icon.
    t.assert(slash.frames, art_dims::slash_frames, "slash frames parsed");
    t.assert(ripspecial.frames, art_dims::ripspecial_frames, "riposte frames parsed");
    t.assert(parry.frames, art_dims::parry_frames, "parry frames parsed");
    t.assert(whirl.frames, art_dims::whirl_frames, "whirl frames parsed");
    t.assert(deflect.frames, art_dims::deflect_frames, "deflect frames parsed");
    t.assert(guard.frames, art_dims::guard_frames, "guard frames parsed");
    t.assert(reload.frames, art_dims::reload_frames, "reload frames parsed");
    t.assert(erase.frames, art_dims::erase_frames, "erase frames parsed");
    t.assert(trail.frames, art_dims::trail_frames, "trail frames parsed");
    t.assert(chip.frames, art_dims::chip_frames, "chip frames parsed");
    t.assert(tail.frames, art_dims::tail_frames, "tail frames parsed");
}

// ------------------------------------------- demo beast sheets (epic nch)

// FNV-1a over one frame's plus-mask bytes; the plane passes are included, so
// two frames match only when every pixel/shade matches.
uint32_t blobFrameHash(const Blob &b, int frame) {
    const int frame_bytes = ((b.h + 7) / 8) * b.w * 3 * 2;
    uint32_t h = 2166136261u;
    for (int i = 0; i < frame_bytes; i++) {
        h ^= static_cast<uint32_t>(b.bytes[frame * frame_bytes + i]);
        h *= 16777619u;
    }
    return h;
}

int maskAt(const Blob &b, int x, int y) {
    return bitAt(y, pixelMask(b, 0, 0, x, y / 8));
}
int planeAt(const Blob &b, int shade, int x, int y) {
    return bitAt(y, pixelData(b, 0, shade, x, y / 8));
}
// Same, but for an arbitrary frame (the heavy tail sheet's facing/stage frames).
int maskAtF(const Blob &b, int frame, int x, int y) {
    return bitAt(y, pixelMask(b, frame, 0, x, y / 8));
}
int planeAtF(const Blob &b, int frame, int shade, int x, int y) {
    return bitAt(y, pixelData(b, frame, shade, x, y / 8));
}

// The three demo beasts ship 32x24x8 sheets with distinct silhouettes; RAVAGER
// keeps the legacy fxmonster. Checks the frame layout, that frame 0 (east idle)
// differs across beasts and from its own west frame, and the signature
// features (crest / two legs, four legs + horns, thick tail).
void testMonsterSheets(Test &t) {
    std::cout << "---------- demo beast sheets distinct ----------" << std::endl;
    Blob chicken, bull, longtail, ravager;
    if (!parseBlob("fxmonster_lunge", chicken, t) || !parseBlob("fxmonster_sweep", bull, t) || !parseBlob("fxmonster_heavy", longtail, t) || !parseBlob("fxmonster", ravager, t))
        return;
    for (const Blob *b : {&chicken, &bull, &longtail}) {
        t.assert(b->w, 32, "beast sheet w");
        t.assert(b->h, 24, "beast sheet h");
        t.assert(b->frames, 14, "beast sheet frames (2 facings x 7 poses)");
    }
    t.assert(ravager.w, 32, "ravager sheet w");
    t.assert(ravager.h, 24, "ravager sheet h");
    t.assert(ravager.frames, 8, "ravager legacy sheet frames");
    // Frame 0 (east idle) is unique per beast and mirrored for west (stride 7).
    const uint32_t hc = blobFrameHash(chicken, 0), hb = blobFrameHash(bull, 0), hl = blobFrameHash(longtail, 0);
    t.assert(hc != hb ? 1 : 0, 1, "chicken != bull frame 0");
    t.assert(hc != hl ? 1 : 0, 1, "chicken != longtail frame 0");
    t.assert(hb != hl ? 1 : 0, 1, "bull != longtail frame 0");
    t.assert(blobFrameHash(chicken, 0) != blobFrameHash(chicken, 7) ? 1 : 0, 1, "chicken east != west");
    // Animation: the two idle frames bob, the windup/attack poses differ.
    for (const Blob *b : {&chicken, &bull, &longtail}) {
        t.assert(blobFrameHash(*b, 0) != blobFrameHash(*b, 1) ? 1 : 0, 1, "idle bob differs");
        t.assert(blobFrameHash(*b, 2) != blobFrameHash(*b, 3) ? 1 : 0, 1, "windup != attack");
        t.assert(blobFrameHash(*b, 3) != blobFrameHash(*b, 0) ? 1 : 0, 1, "attack != idle");
    }

    // Chicken: layered tail plumes fill the left of the cell (body plane0 at
    // (2,6) and (2,10)); two separated dark legs with a clear gap; a white comb
    // above the head; a black eye inside the white head; a black beak.
    t.assert(planeAt(chicken, 0, 2, 6), 1, "chicken upper tail plume");
    t.assert(planeAt(chicken, 0, 2, 10), 1, "chicken tail plume body");
    // The legs render in DARK, not the shade-0 `lo` eraser, so the plane-0 bit
    // must be lit at the leg pixels -- on the old BLACK art planeAt was 0 and
    // these fail. The gap and outer-clear masks still pin the silhouette.
    t.assert(maskAt(chicken, 11, 20), 1, "chicken near leg");
    t.assert(planeAt(chicken, 0, 11, 20), 1, "chicken near leg plane0 ink");
    t.assert(maskAt(chicken, 16, 20), 1, "chicken far leg");
    t.assert(planeAt(chicken, 0, 16, 20), 1, "chicken far leg plane0 ink");
    t.assert(planeAt(chicken, 0, 12, 20), 1, "chicken near shank plane0 ink");
    t.assert(planeAt(chicken, 0, 17, 20), 1, "chicken far shank plane0 ink");
    t.assert(maskAt(chicken, 14, 20), 0, "chicken clear between legs");
    t.assert(maskAt(chicken, 4, 20), 0, "chicken no outer leg");
    t.assert(planeAt(chicken, 2, 22, 0), 1, "chicken comb white");
    t.assert(planeAt(chicken, 2, 23, 2), 0, "chicken eye not white");
    t.assert(maskAt(chicken, 23, 2), 1, "chicken eye ink");
    t.assert(maskAt(chicken, 30, 5), 1, "chicken beak ink");

    // Bull: a hanging tail (body plane0 at (1,10)); four separated dark legs
    // with a clear gap; two white horns above the low head; the broad body
    // plane0 at (10,10); a black eye inside the head.
    t.assert(planeAt(bull, 0, 1, 10), 1, "bull tail");
    t.assert(maskAt(bull, 5, 20), 1, "bull leg 1");
    t.assert(maskAt(bull, 10, 20), 1, "bull leg 2");
    t.assert(maskAt(bull, 19, 20), 1, "bull leg 3");
    t.assert(maskAt(bull, 24, 20), 1, "bull leg 4");
    t.assert(maskAt(bull, 15, 20), 0, "bull clear between legs");
    t.assert(planeAt(bull, 2, 24, 6), 1, "bull near horn");
    t.assert(planeAt(bull, 2, 29, 6), 1, "bull far horn");
    t.assert(planeAt(bull, 0, 10, 10), 1, "bull broad body");
    t.assert(maskAt(bull, 25, 12), 1, "bull eye ink");
    t.assert(planeAt(bull, 2, 25, 12), 0, "bull eye not white");

    // Longtail: a thick segmented tail fills the left of the cell (plane0 at
    // (2,6) and (2,10)) with a dark segment line; four separated legs; a
    // forward white head; a dark jaw line under the snout.
    t.assert(planeAt(longtail, 0, 2, 6), 1, "longtail ridge spike");
    t.assert(planeAt(longtail, 0, 2, 10), 1, "longtail tail body");
    t.assert(planeAt(longtail, 0, 3, 10), 0, "longtail tail segment line");
    t.assert(maskAt(longtail, 10, 20), 1, "longtail leg 1");
    t.assert(maskAt(longtail, 15, 20), 1, "longtail leg 2");
    t.assert(maskAt(longtail, 20, 20), 1, "longtail leg 3");
    t.assert(maskAt(longtail, 25, 20), 1, "longtail leg 4");
    t.assert(maskAt(longtail, 13, 20), 0, "longtail clear between legs");
    t.assert(planeAt(longtail, 2, 22, 6), 1, "longtail forward head");
    t.assert(maskAt(longtail, 28, 11), 1, "longtail jaw ink");
    t.assert(planeAt(longtail, 2, 28, 11), 0, "longtail jaw not white");
}

// ------------------------------------------- chicken attack overlay (nch.8)

// fxchickenatk is the chicken's peck/leap overlay: a 4-frame 32x24 sheet in
// [peck E, peck W, leap E, leap W] order, drawn during both windup and attack.
// Both attacks LOWER the head onto the target (peck to rows 4..9, leap to rows
// 3..8) with the BLACK beak as an erase notch at the lowered head's front edge;
// the leap also lifts the body 2 px and folds the legs (feet at y18 vs the
// planted y21). West frames must be the exact horizontal mirror of east.
void testChickenAttackSheet(Test &t) {
    std::cout << "---------- chicken attack sheet ----------" << std::endl;
    Blob atk;
    if (!parseBlob("fxchickenatk", atk, t))
        return;
    t.assert(atk.w, art_dims::chickenatk_frame_w, "chickenatk blob frame w");
    t.assert(atk.h, art_dims::chickenatk_frame_h, "chickenatk blob frame h");
    t.assert(atk.frames, art_dims::chickenatk_frames, "chickenatk blob frames");
    t.assert(art_dims::chickenatk_frame_w, 32, "chickenatk frame w");
    t.assert(art_dims::chickenatk_frame_h, 24, "chickenatk frame h");
    t.assert(art_dims::chickenatk_frames, 4, "chickenatk frames");

    // Frame 0 peck E: feet stay planted (dark ink at y21), the head lowers to
    // rows 4..9 (white ink on plane 2 at the front) and the beak/eye are the
    // body-tone `lo` (BLACK for the dark idle body), so they pin as opaque
    // erasers: mask 1, plane 0 clear. The idle high head row (y1) is clear.
    t.assert(planeAtF(atk, 0, 0, 12, 21), 1, "peck foot planted plane0");
    t.assert(maskAtF(atk, 0, 10, 2), 0, "peck body not raised");
    t.assert(planeAtF(atk, 0, 2, 27, 5), 1, "peck lowered head white");
    t.assert(planeAtF(atk, 0, 2, 25, 1), 0, "peck high head clear");
    t.assert(maskAtF(atk, 0, 28, 7), 1, "peck beak notch ink");
    t.assert(planeAtF(atk, 0, 0, 28, 7), 0, "peck beak black eraser");
    t.assert(maskAtF(atk, 0, 24, 5), 1, "peck eye ink");
    t.assert(planeAtF(atk, 0, 0, 24, 5), 0, "peck eye black eraser");
    t.assert(planeAtF(atk, 0, 2, 2, 1), 0, "peck head not on the tail side");

    // Frame 2 leap E: body raised (ink at y2), head lowered to rows 3..8 (the
    // idle y0 row clear), legs tucked (ink at y18) and the planted y21 row clear.
    t.assert(planeAtF(atk, 2, 0, 10, 2), 1, "leap raised body plane0");
    t.assert(planeAtF(atk, 2, 2, 27, 5), 1, "leap lowered head white");
    t.assert(planeAtF(atk, 2, 2, 25, 0), 0, "leap high head clear");
    t.assert(maskAtF(atk, 2, 28, 7), 1, "leap beak notch ink");
    t.assert(planeAtF(atk, 2, 0, 12, 18), 1, "leap tucked foot plane0");
    t.assert(maskAtF(atk, 2, 12, 21), 0, "leap planted row clear");

    // West frames are the exact horizontal mirrors (1<->0, 3<->2).
    auto mirrored = [&](int a, int b) {
        for (int shade = 0; shade < 3; shade++)
            for (int page = 0; page < 3; page++)
                for (int x = 0; x < atk.w; x++) {
                    if (pixelData(atk, a, shade, x, page) != pixelData(atk, b, shade, atk.w - 1 - x, page))
                        return false;
                    if (pixelMask(atk, a, shade, x, page) != pixelMask(atk, b, shade, atk.w - 1 - x, page))
                        return false;
                }
        return true;
    };
    t.assert(mirrored(0, 1) ? 1 : 0, 1, "chickenatk west peck mirrors east");
    t.assert(mirrored(2, 3) ? 1 : 0, 1, "chickenatk west leap mirrors east");

    // All four frames differ, so both attacks and both facings are distinct.
    uint32_t h[4];
    for (int i = 0; i < 4; i++)
        h[i] = blobFrameHash(atk, i);
    for (int i = 0; i < 4; i++)
        for (int j = i + 1; j < 4; j++)
            t.assert(h[i] != h[j] ? 1 : 0, 1, "chickenatk frames distinct");
}

// ------------------------------------------- bull attack overlay (nch.10)

// fxbullatk is the bull's stomp/gore overlay: a 4-frame 32x24 sheet in
// [stomp E, stomp W, gore E, gore W] order, drawn during both windup and
// attack. The stomp raises both front hooves (tucked back under the chest),
// pitches the body forward onto the planted rear legs and holds the head/horns
// high; the gore lowers the head, drives the horns forward along the facing
// edge, leans the body 1 px and raises the tail. West frames must be the exact
// horizontal mirror of east.
void testBullAttackSheet(Test &t) {
    std::cout << "---------- bull attack sheet ----------" << std::endl;
    Blob atk;
    if (!parseBlob("fxbullatk", atk, t))
        return;
    t.assert(atk.w, art_dims::bullatk_frame_w, "bullatk blob frame w");
    t.assert(atk.h, art_dims::bullatk_frame_h, "bullatk blob frame h");
    t.assert(atk.frames, art_dims::bullatk_frames, "bullatk blob frames");
    t.assert(art_dims::bullatk_frame_w, 32, "bullatk frame w");
    t.assert(art_dims::bullatk_frame_h, 24, "bullatk frame h");
    t.assert(art_dims::bullatk_frames, 4, "bullatk frames");

    // Frame 0 stomp E: rear hooves planted (ink at y22), front hooves raised and
    // tucked back over the chest (the BLACK hoof at y14 overwrites the DARK body
    // there, so mask 1 + plane0 clear), front shoulder raised (body ink at y7)
    // and the head held high (white at y4). The clear y3 tail pixel proves the
    // tail is not the raised gore tail.
    t.assert(maskAtF(atk, 0, 4, 22), 1, "stomp rear hoof planted");
    t.assert(maskAtF(atk, 0, 16, 14), 1, "stomp front hoof ink");
    t.assert(planeAtF(atk, 0, 0, 16, 14), 0, "stomp front hoof black eraser");
    t.assert(planeAtF(atk, 0, 0, 16, 8), 1, "stomp body behind hoof plane0");
    t.assert(planeAtF(atk, 0, 0, 20, 7), 1, "stomp raised front shoulder");
    t.assert(planeAtF(atk, 0, 2, 25, 4), 1, "stomp head high white");
    t.assert(planeAtF(atk, 0, 2, 25, 17), 0, "stomp head not low");
    t.assert(maskAtF(atk, 0, 1, 3), 0, "stomp tail not raised");

    // Frame 2 gore E: head lowered (white at y17, nothing high at y4), horns
    // driven forward along the facing edge (white at (30,12)), body leaned 1 px
    // forward and the tail raised (body ink at y3). The hoof row is normal body
    // there (plane0 lit) -- no raised-hoof eraser.
    t.assert(planeAtF(atk, 2, 0, 1, 3), 1, "gore tail raised plane0");
    t.assert(planeAtF(atk, 2, 2, 25, 17), 1, "gore head low white");
    t.assert(maskAtF(atk, 2, 25, 4), 0, "gore head not high");
    t.assert(planeAtF(atk, 2, 2, 30, 12), 1, "gore horn forward white");
    t.assert(planeAtF(atk, 2, 0, 16, 14), 1, "gore hoof row planted body");

    // West frames are the exact horizontal mirrors (1<->0, 3<->2).
    auto mirrored = [&](int a, int b) {
        for (int shade = 0; shade < 3; shade++)
            for (int page = 0; page < 3; page++)
                for (int x = 0; x < atk.w; x++) {
                    if (pixelData(atk, a, shade, x, page) != pixelData(atk, b, shade, atk.w - 1 - x, page))
                        return false;
                    if (pixelMask(atk, a, shade, x, page) != pixelMask(atk, b, shade, atk.w - 1 - x, page))
                        return false;
                }
        return true;
    };
    t.assert(mirrored(0, 1) ? 1 : 0, 1, "bullatk west stomp mirrors east");
    t.assert(mirrored(2, 3) ? 1 : 0, 1, "bullatk west gore mirrors east");

    // All four frames differ, so both attacks and both facings are distinct.
    uint32_t h[4];
    for (int i = 0; i < 4; i++)
        h[i] = blobFrameHash(atk, i);
    for (int i = 0; i < 4; i++)
        for (int j = i + 1; j < 4; j++)
            t.assert(h[i] != h[j] ? 1 : 0, 1, "bullatk frames distinct");
}

// ------------------------------------------- breakable-zone part overlays (kt7.6)

// The four demo-roster part sheets share the heavy tail overlay contract:
// 4 frames in combatPartArtFrame order, west frames the exact horizontal mirror
// of east, both broken frames differing from their intact partner and carrying
// shade-0 (mask on, all three planes off) erase pixels over the part the intact
// frame repaints. Frame dimensions match the data zone boxes padded to a
// multiple-of-8 height for the SpritesU plus-mask page stride.
bool partFrameMirrors(const Blob &b, int a, int c) {
    for (int shade = 0; shade < 3; shade++)
        for (int page = 0; page < (b.h + 7) / 8; page++)
            for (int x = 0; x < b.w; x++) {
                if (pixelData(b, a, shade, x, page) != pixelData(b, c, shade, b.w - 1 - x, page))
                    return false;
                if (pixelMask(b, a, shade, x, page) != pixelMask(b, c, shade, b.w - 1 - x, page))
                    return false;
            }
    return true;
}

// Count opaque shade-0 pixels (mask 1, every plane 0): the erasers a broken
// frame draws over the baked part before the damaged variant.
int partErasePixels(const Blob &b, int frame) {
    int n = 0;
    for (int page = 0; page < (b.h + 7) / 8; page++)
        for (int x = 0; x < b.w; x++)
            for (int y = page * 8; y < page * 8 + 8; y++) {
                if (bitAt(y, pixelMask(b, frame, 0, x, page)) == 0)
                    continue;
                if (bitAt(y, pixelData(b, frame, 0, x, page)) == 0 && bitAt(y, pixelData(b, frame, 1, x, page)) == 0 && bitAt(y, pixelData(b, frame, 2, x, page)) == 0)
                    n++;
            }
    return n;
}

void testZonePartSheets(Test &t) {
    std::cout << "---------- breakable-zone part overlays ----------" << std::endl;

    // Chicken head (lunge.json head box 18,0,11x7): frame-local (0,0) = cell
    // (18,0). East intact is the baked white head with its black eye/beak; the
    // broken frame erases it and drops a dark neck stump at the body end.
    Blob ch;
    if (parseBlob("fxhead_chicken", ch, t)) {
        t.assert(ch.w, art_dims::head_chicken_frame_w, "chicken head blob frame w");
        t.assert(ch.h, art_dims::head_chicken_frame_h, "chicken head blob frame h");
        t.assert(ch.frames, art_dims::head_chicken_frames, "chicken head blob frames");
        t.assert(art_dims::head_chicken_frame_w, 11, "chicken head frame w");
        t.assert(art_dims::head_chicken_frame_h, 8, "chicken head frame h");
        t.assert(art_dims::head_chicken_frames, 4, "chicken head frames");
        t.assert(planeAtF(ch, 0, 2, 7, 1), 1, "chicken head east white crown");
        t.assert(maskAtF(ch, 0, 5, 2), 1, "chicken head east eye ink");
        t.assert(planeAtF(ch, 0, 0, 5, 2), 0, "chicken head east eye black");
        t.assert(maskAtF(ch, 0, 10, 3), 1, "chicken head east beak ink");
        t.assert(maskAtF(ch, 0, 0, 7), 0, "chicken head east bottom row clear");
        t.assert(planeAtF(ch, 1, 2, 7, 1), 0, "chicken head broken crown erased");
        t.assert(planeAtF(ch, 1, 0, 1, 2), 1, "chicken head broken stump plane0");
        t.assert(partErasePixels(ch, 1) > 0 ? 1 : 0, 1, "chicken head east broken erase pixels");
        t.assert(partErasePixels(ch, 3) > 0 ? 1 : 0, 1, "chicken head west broken erase pixels");
        t.assert(partFrameMirrors(ch, 0, 2) ? 1 : 0, 1, "chicken head west intact mirrors east");
        t.assert(partFrameMirrors(ch, 1, 3) ? 1 : 0, 1, "chicken head west broken mirrors east");
        t.assert(blobFrameHash(ch, 0) != blobFrameHash(ch, 1) ? 1 : 0, 1, "chicken head broken != intact");
    }

    // Chicken legs (lunge.json appendage box 9,0,9x24): frame-local (0,0) =
    // cell (9,0). East intact is the baked DARK legs with LIGHT shank/foot
    // highlights; the broken frame shears them below the thigh.
    Blob cl;
    if (parseBlob("fxlegs_chicken", cl, t)) {
        t.assert(cl.w, art_dims::legs_chicken_frame_w, "chicken legs blob frame w");
        t.assert(cl.h, art_dims::legs_chicken_frame_h, "chicken legs blob frame h");
        t.assert(cl.frames, art_dims::legs_chicken_frames, "chicken legs blob frames");
        t.assert(art_dims::legs_chicken_frame_w, 9, "chicken legs frame w");
        t.assert(art_dims::legs_chicken_frame_h, 24, "chicken legs frame h");
        t.assert(art_dims::legs_chicken_frames, 4, "chicken legs frames");
        t.assert(planeAtF(cl, 0, 0, 2, 20), 1, "chicken legs east near shank plane0");
        t.assert(planeAtF(cl, 0, 0, 7, 20), 1, "chicken legs east far shank plane0");
        t.assert(maskAtF(cl, 0, 5, 20), 0, "chicken legs east gap clear");
        t.assert(planeAtF(cl, 0, 0, 0, 21), 1, "chicken legs east foot plane0");
        t.assert(planeAtF(cl, 1, 0, 2, 20), 0, "chicken legs broken shank erased");
        t.assert(planeAtF(cl, 1, 0, 2, 13), 1, "chicken legs broken thigh stump plane0");
        t.assert(partErasePixels(cl, 1) > 0 ? 1 : 0, 1, "chicken legs east broken erase pixels");
        t.assert(partErasePixels(cl, 3) > 0 ? 1 : 0, 1, "chicken legs west broken erase pixels");
        t.assert(partFrameMirrors(cl, 0, 2) ? 1 : 0, 1, "chicken legs west intact mirrors east");
        t.assert(partFrameMirrors(cl, 1, 3) ? 1 : 0, 1, "chicken legs west broken mirrors east");
        t.assert(blobFrameHash(cl, 0) != blobFrameHash(cl, 1) ? 1 : 0, 1, "chicken legs broken != intact");
    }

    // Bull head (sweep.json head box 17,-4,12x10): frame-local (0,0) = cell
    // (17,-4), so the baked horns and head top land in frame rows 8..15. East
    // intact is the white horn/ear art; the broken frame erases the horn band
    // and draws short dark stumps while repainting the head top.
    Blob bh;
    if (parseBlob("fxhead_bull", bh, t)) {
        t.assert(bh.w, art_dims::head_bull_frame_w, "bull head blob frame w");
        t.assert(bh.h, art_dims::head_bull_frame_h, "bull head blob frame h");
        t.assert(bh.frames, art_dims::head_bull_frames, "bull head blob frames");
        t.assert(art_dims::head_bull_frame_w, 12, "bull head frame w");
        t.assert(art_dims::head_bull_frame_h, 16, "bull head frame h");
        t.assert(art_dims::head_bull_frames, 4, "bull head frames");
        t.assert(planeAtF(bh, 0, 2, 6, 9), 1, "bull head east horn mid white");
        t.assert(planeAtF(bh, 0, 2, 8, 8), 1, "bull head east horn tip white");
        t.assert(planeAtF(bh, 0, 2, 6, 14), 1, "bull head east head top white");
        t.assert(maskAtF(bh, 0, 4, 8), 0, "bull head east above horn clear");
        t.assert(maskAtF(bh, 1, 6, 9), 1, "bull head broken horn erase covered");
        t.assert(planeAtF(bh, 1, 2, 6, 9), 0, "bull head broken horn erased");
        t.assert(planeAtF(bh, 1, 0, 5, 12), 1, "bull head broken horn stump plane0");
        t.assert(planeAtF(bh, 1, 2, 6, 14), 1, "bull head broken head top stays white");
        t.assert(partErasePixels(bh, 1) > 0 ? 1 : 0, 1, "bull head east broken erase pixels");
        t.assert(partErasePixels(bh, 3) > 0 ? 1 : 0, 1, "bull head west broken erase pixels");
        t.assert(partFrameMirrors(bh, 0, 2) ? 1 : 0, 1, "bull head west intact mirrors east");
        t.assert(partFrameMirrors(bh, 1, 3) ? 1 : 0, 1, "bull head west broken mirrors east");
        t.assert(blobFrameHash(bh, 0) != blobFrameHash(bh, 1) ? 1 : 0, 1, "bull head broken != intact");
    }

    // Bull hooves (sweep.json appendage box 4,12,20x10): frame-local (0,0) =
    // cell (4,12). East intact is the baked DARK legs with LIGHT shanks and
    // BLACK hooves; the broken frame cuts them to short stumps with no hooves.
    Blob bv;
    if (parseBlob("fxhooves_bull", bv, t)) {
        t.assert(bv.w, art_dims::hooves_bull_frame_w, "bull hooves blob frame w");
        t.assert(bv.h, art_dims::hooves_bull_frame_h, "bull hooves blob frame h");
        t.assert(bv.frames, art_dims::hooves_bull_frames, "bull hooves blob frames");
        t.assert(art_dims::hooves_bull_frame_w, 20, "bull hooves frame w");
        t.assert(art_dims::hooves_bull_frame_h, 16, "bull hooves frame h");
        t.assert(art_dims::hooves_bull_frames, 4, "bull hooves frames");
        t.assert(planeAtF(bv, 0, 0, 1, 6), 1, "bull hooves east leg plane0");
        t.assert(planeAtF(bv, 0, 0, 6, 6), 1, "bull hooves east second leg plane0");
        t.assert(maskAtF(bv, 0, 4, 6), 0, "bull hooves east leg gap clear");
        t.assert(maskAtF(bv, 0, 1, 10), 1, "bull hooves east hoof ink");
        t.assert(planeAtF(bv, 0, 0, 1, 10), 0, "bull hooves east hoof black eraser");
        t.assert(planeAtF(bv, 1, 0, 1, 9), 0, "bull hooves broken shank erased");
        t.assert(planeAtF(bv, 1, 0, 1, 6), 1, "bull hooves broken stump plane0");
        t.assert(planeAtF(bv, 1, 0, 1, 10), 0, "bull hooves broken hoof erased");
        t.assert(partErasePixels(bv, 1) > 0 ? 1 : 0, 1, "bull hooves east broken erase pixels");
        t.assert(partErasePixels(bv, 3) > 0 ? 1 : 0, 1, "bull hooves west broken erase pixels");
        t.assert(partFrameMirrors(bv, 0, 2) ? 1 : 0, 1, "bull hooves west intact mirrors east");
        t.assert(partFrameMirrors(bv, 1, 3) ? 1 : 0, 1, "bull hooves west broken mirrors east");
        t.assert(blobFrameHash(bv, 0) != blobFrameHash(bv, 1) ? 1 : 0, 1, "bull hooves broken != intact");
    }
}

// ------------------------------------------- heavy long-tail overlay (4t4)

// fxtail_heavy is the HEAVY appendage overlay: 24x16x4 in combatPartArtFrame
// order (east intact / east broken / west intact / west broken), frame origin =
// the heavy.json appendage box top-left. Height 16 is a multiple of 8 so the
// SpritesU plus-mask page stride is exact at draw time. The west frames must be
// the exact horizontal mirror of the east frames.
void testHeavyTail(Test &t) {
    std::cout << "---------- heavy tail overlay sheet ----------" << std::endl;
    Blob tail;
    if (!parseBlob("fxtail_heavy", tail, t))
        return;
    t.assert(tail.w, 24, "heavy tail sheet w");
    t.assert(tail.h, 16, "heavy tail sheet h");
    t.assert(tail.frames, 4, "heavy tail sheet frames");

    // East intact: light tip at the far left (plane0), white cap on the tip
    // (plane2), dark underside (plane0 only), light root at the right.
    t.assert(maskAtF(tail, 0, 0, 7), 1, "heavy tail east tip ink");
    t.assert(planeAtF(tail, 0, 0, 0, 9), 1, "heavy tail east tip plane0");
    t.assert(planeAtF(tail, 0, 2, 0, 8), 1, "heavy tail east tip white cap");
    t.assert(planeAtF(tail, 0, 2, 3, 8), 0, "heavy tail east cap ends at x3");
    t.assert(planeAtF(tail, 0, 0, 23, 8), 1, "heavy tail east root plane0");
    t.assert(planeAtF(tail, 0, 2, 22, 5), 1, "heavy tail east root highlight white");
    t.assert(planeAtF(tail, 0, 0, 10, 12), 1, "heavy tail east underside dark");
    t.assert(planeAtF(tail, 0, 1, 10, 12), 0, "heavy tail east underside dark only");
    t.assert(maskAtF(tail, 0, 12, 3), 0, "heavy tail east above root clear");
    t.assert(maskAtF(tail, 0, 23, 15), 0, "heavy tail east below root clear");

    // East broken: stub at the root only; the tip is gone.
    t.assert(maskAtF(tail, 1, 0, 8), 0, "heavy tail east broken clears tip");
    t.assert(planeAtF(tail, 1, 0, 20, 8), 1, "heavy tail east broken stub plane0");
    t.assert(planeAtF(tail, 1, 1, 21, 4), 1, "heavy tail east broken stump light");
    t.assert(planeAtF(tail, 1, 0, 23, 13), 1, "heavy tail east broken stub base");

    // West intact/broken are the exact horizontal mirrors.
    t.assert(planeAtF(tail, 2, 0, 23, 9), 1, "heavy tail west tip plane0");
    t.assert(planeAtF(tail, 2, 2, 23, 8), 1, "heavy tail west tip white cap");
    t.assert(planeAtF(tail, 2, 0, 0, 8), 1, "heavy tail west root plane0");
    t.assert(maskAtF(tail, 3, 23, 8), 0, "heavy tail west broken clears tip");
    t.assert(planeAtF(tail, 3, 0, 3, 8), 1, "heavy tail west broken stub plane0");

    auto mirrored = [&](int a, int b) {
        for (int shade = 0; shade < 3; shade++)
            for (int page = 0; page < 2; page++)
                for (int x = 0; x < tail.w; x++) {
                    if (pixelData(tail, a, shade, x, page) != pixelData(tail, b, shade, tail.w - 1 - x, page))
                        return false;
                    if (pixelMask(tail, a, shade, x, page) != pixelMask(tail, b, shade, tail.w - 1 - x, page))
                        return false;
                }
        return true;
    };
    t.assert(mirrored(0, 2) ? 1 : 0, 1, "heavy tail west mirrors east");
    t.assert(mirrored(1, 3) ? 1 : 0, 1, "heavy tail west broken mirrors east broken");
}

// ------------------------------------------- heavy tail-spin overlay (nch.1)

// fxtail_spin is HEAVY's tail_spin overlay: 24x24 x4 frames in world direction
// order W / N / E / S, the tail rooted at the frame centre (12,12), so the
// render draws it at body centre - (12,12). Each frame is the east tail rotated
// a quarter turn CW about the centre; the white tip cap (plane 2) lands on the
// frame edge facing that world direction, which is the pixel the device test
// reads to prove the direction pick.
void testTailSpin(Test &t) {
    std::cout << "---------- heavy tail-spin overlay ----------" << std::endl;
    Blob spin;
    if (!parseBlob("fxtail_spin", spin, t))
        return;
    t.assert(spin.w, art_dims::tail_spin_frame_w, "tail_spin blob frame w");
    t.assert(spin.h, art_dims::tail_spin_frame_h, "tail_spin blob frame h");
    t.assert(spin.frames, art_dims::tail_spin_frames, "tail_spin blob frames");
    t.assert(art_dims::tail_spin_frame_w, 24, "tail_spin frame w");
    t.assert(art_dims::tail_spin_frame_h, 24, "tail_spin frame h");
    t.assert(art_dims::tail_spin_frames, 4, "tail_spin frames");

    // Root segment sits on/near the body centre in every frame (the tail is
    // rooted there), so the frame anchor is exact.
    t.assert(maskAtF(spin, 0, 10, 12), 1, "west root near centre");
    t.assert(maskAtF(spin, 1, 12, 10), 1, "north root near centre");
    t.assert(maskAtF(spin, 2, 12, 12), 1, "east root at centre");
    t.assert(maskAtF(spin, 3, 12, 12), 1, "south root at centre");

    // White tip cap faces its world direction: W frame at x0..1, E at x22..23,
    // N at y0..1, S at y22..23 (plane 2 only).
    t.assert(planeAtF(spin, 0, 2, 0, 11), 1, "west cap plane2");
    t.assert(planeAtF(spin, 0, 2, 1, 12), 1, "west cap plane2 row12");
    t.assert(planeAtF(spin, 2, 2, 22, 11), 1, "east cap plane2");
    t.assert(planeAtF(spin, 2, 2, 23, 12), 1, "east cap plane2 row12");
    t.assert(planeAtF(spin, 1, 2, 11, 0), 1, "north cap plane2");
    t.assert(planeAtF(spin, 1, 2, 12, 1), 1, "north cap plane2 col12");
    t.assert(planeAtF(spin, 3, 2, 11, 22), 1, "south cap plane2");
    t.assert(planeAtF(spin, 3, 2, 12, 23), 1, "south cap plane2 col12");
    // The cap is on the facing edge, not the opposite one.
    t.assert(planeAtF(spin, 2, 2, 0, 11), 0, "east frame west edge clear");
    t.assert(planeAtF(spin, 0, 2, 22, 11), 0, "west frame east edge clear");
    t.assert(planeAtF(spin, 3, 2, 11, 0), 0, "south frame north edge clear");
    t.assert(planeAtF(spin, 1, 2, 11, 22), 0, "north frame south edge clear");

    // The dark underside stays dark (plane0 only).
    t.assert(planeAtF(spin, 2, 0, 13, 14), 1, "east underside plane0");
    t.assert(planeAtF(spin, 2, 1, 13, 14), 0, "east underside dark only");

    // Every world frame differs (the direction pick is observable).
    const uint32_t w = blobFrameHash(spin, 0), n = blobFrameHash(spin, 1);
    const uint32_t e = blobFrameHash(spin, 2), s = blobFrameHash(spin, 3);
    t.assert(w != n ? 1 : 0, 1, "west != north");
    t.assert(w != e ? 1 : 0, 1, "west != east");
    t.assert(w != s ? 1 : 0, 1, "west != south");
    t.assert(n != e ? 1 : 0, 1, "north != east");
}

// -------------------------------------------- training-pole variant sheets
// Beads monhun-ardu-6zb.5 / 6zb.7 / 6zb.10: PLAIN keeps the legacy 2-frame
// 20x40 sheet; each breakable variant is a 24x40 6-frame sheet in stage*2 +
// flash order (intact, intact-flash, damaged, damaged-flash, broken,
// broken-flash). The pole is a 16-px DARK post centered at x4..20 and the
// breakable part is a LIGHT additive shape spanning the full 24 px (so it
// protrudes 4 px past the post on each side) with a WHITE highlight, a BLACK
// seam and the neutral 7-px jagged fracture marker (BLACK on LIGHT). Tests pin
// the part protrusion (cap/collar margins, horn tip), the marker stages
// (7/5/0 px), the damaged/broken stage differences and the broken ground piece.
void testPoleSheets(Test &t) {
    Blob plain, sever, brk, crack;
    t.assert(parseBlob("fxpole", plain, t), 1, "plain pole blob");
    // fxpole is the legacy 20x40 2-frame sheet: byte-identical to before.
    t.assert(plain.w, 20, "plain pole w");
    t.assert(plain.h, 40, "plain pole h");
    t.assert(plain.frames, 2, "plain pole 2 frames");

    // Opaque pixels of a target shade in a half-open rect: 0 BLACK, 1 DARK,
    // 2 LIGHT, 3 WHITE (L4 triplane decode), transparent skipped.
    auto shadeInk = [](const Blob &b, int frame, int shade, int x0, int y0, int x1, int y1) {
        int n = 0;
        for (int y = y0; y < y1; y++) {
            for (int x = x0; x < x1; x++) {
                if (!bitAt(y, pixelMask(b, frame, 0, x, y / 8)))
                    continue;
                const int p0 = bitAt(y, pixelData(b, frame, 0, x, y / 8));
                const int p1 = bitAt(y, pixelData(b, frame, 1, x, y / 8));
                const int p2 = bitAt(y, pixelData(b, frame, 2, x, y / 8));
                const int s = p2 ? 3 : (p1 ? 2 : (p0 ? 1 : 0));
                if (s == shade)
                    n++;
            }
        }
        return n;
    };
    auto anyInk = [](const Blob &b, int frame, int x0, int y0, int x1, int y1) {
        int n = 0;
        for (int y = y0; y < y1; y++)
            for (int x = x0; x < x1; x++)
                n += bitAt(y, pixelMask(b, frame, 0, x, y / 8));
        return n;
    };

    const char *const syms[3] = {"fxpole_sever", "fxpole_break", "fxpole_crack"};
    Blob *const blobs[3] = {&sever, &brk, &crack};
    // Marker rect (mx+1..mx+3, my..my+4) holding the 7-px stamp, and a
    // guaranteed-LIGHT sample beside it.
    const int mbox[3][4] = {{10, 3, 13, 8}, {17, 5, 20, 10}, {11, 21, 14, 26}};
    const int lite[3][2] = {{7, 6}, {16, 10}, {8, 23}};
    for (int vi = 0; vi < 3; vi++) {
        Blob &b = *blobs[vi];
        const std::string tag = syms[vi];
        if (!parseBlob(syms[vi], b, t))
            continue;
        t.assert(b.frames, 6, tag + " 6 frames");
        t.assert(b.w, 24, tag + " w 24");
        t.assert(b.h, 40, tag + " h 40");
        const size_t fb = b.bytes.size() / 6;

        // Each stage differs from its neighbours and every flash frame differs
        // from its non-flash pair, so no stage collapses to another.
        auto bytesDiffer = [&](size_t a, size_t c) {
            int diff = 0;
            for (size_t i = 0; i < fb; i++)
                if (b.bytes[a * fb + i] != b.bytes[c * fb + i])
                    diff++;
            return diff;
        };
        t.assert(bytesDiffer(0, 1) > 0, 1, tag + " intact flash differs");
        t.assert(bytesDiffer(2, 3) > 0, 1, tag + " damaged flash differs");
        t.assert(bytesDiffer(4, 5) > 0, 1, tag + " broken flash differs");
        t.assert(bytesDiffer(0, 2) > 0, 1, tag + " damaged differs from intact");
        t.assert(bytesDiffer(2, 4) > 0, 1, tag + " broken differs from damaged");

        // Neutral fracture marker on the LIGHT part: 7 px intact, chipped to
        // 5 px when damaged, gone once the part detaches.
        const int *m = mbox[vi];
        t.assert(shadeInk(b, 0, 0, m[0], m[1], m[2], m[3]), 7, tag + " intact 7-px marker");
        t.assert(shadeInk(b, 2, 0, m[0], m[1], m[2], m[3]), 5, tag + " damaged 5-px marker");
        t.assert(shadeInk(b, 4, 0, m[0], m[1], m[2], m[3]), 0, tag + " broken marker gone");
        // The part behind the marker is LIGHT (contrast), and it flashes WHITE.
        t.assert(shadeInk(b, 0, 2, lite[vi][0], lite[vi][1], lite[vi][0] + 1, lite[vi][1] + 1), 1, tag + " LIGHT part behind marker");
        t.assert(shadeInk(b, 1, 3, lite[vi][0], lite[vi][1], lite[vi][0] + 1, lite[vi][1] + 1), 1, tag + " part flashes WHITE");

        // Every variant has a broken ground piece; intact/damaged stay clear.
        t.assert(anyInk(b, 0, 0, 36, b.w, 40), 0, tag + " intact ground clear");
        t.assert(anyInk(b, 2, 0, 36, b.w, 40), 0, tag + " damaged ground clear");
        t.assert(anyInk(b, 4, 0, 36, b.w, 40) > 0, 1, tag + " broken ground piece ink");
        t.assert(anyInk(b, 5, 0, 36, b.w, 40) > 0, 1, tag + " broken-flash ground piece ink");
    }

    // The additive parts protrude 4 px past the 16 px DARK post on both sides
    // (SEVER cap rows 0..14, CRACK collar rows 18..30); BREAK's horn reaches
    // the right margin near the top.
    t.assert(shadeInk(sever, 0, 2, 0, 0, 4, 14) > 0, 1, "sever cap left margin");
    t.assert(shadeInk(sever, 0, 2, 20, 0, 24, 14) > 0, 1, "sever cap right margin");
    t.assert(shadeInk(crack, 0, 2, 0, 18, 4, 30) > 0, 1, "crack collar left margin");
    t.assert(shadeInk(crack, 0, 2, 20, 18, 24, 30) > 0, 1, "crack collar right margin");
    t.assert(shadeInk(brk, 0, 2, 20, 0, 24, 16) > 0, 1, "break horn protrudes right");
    t.assert(shadeInk(brk, 0, 1, 4, 12, 20, 36) > 0, 1, "break post sits under the horn");
    // SEVER loses the cap when broken (no ink above the stump at y12); BREAK
    // leaves a horn-base stub and CRACK a displaced collar chunk.
    t.assert(anyInk(sever, 4, 0, 0, 24, 12), 0, "sever broken cap gone");
    t.assert(anyInk(brk, 4, 10, 11, 18, 15) > 0, 1, "break broken base stub");
    t.assert(anyInk(crack, 4, 0, 16, 24, 20) > 0, 1, "crack broken displaced chunk");
}

// ------------------------------------------- heavy rotating spin sheet (nch.3)

// fxtailspin is HEAVY's real spin body: the east longtail silhouette in an
// 8-frame 40x40 plus-mask sheet, frame i rotated i*45 deg clockwise about the
// body centre. Frame 0 is the east beast; the white head orbits the centre as
// the sheet steps, which is the observable rotation signature (body/tail are
// DARK, the head is the only WHITE ink). Shades stay one of the four authored
// palette entries (no interpolation), so a WHITE pixel has planes 0+1+2, a
// LIGHT one 0+1, a DARK one 0 only and the BLACK shadow is an opaque eraser.
void testTailSpinSheet(Test &t) {
    std::cout << "---------- heavy rotating spin sheet ----------" << std::endl;
    Blob spin;
    if (!parseBlob("fxtailspin", spin, t))
        return;
    t.assert(spin.w, art_dims::tailspin_frame_w, "tailspin blob frame w");
    t.assert(spin.h, art_dims::tailspin_frame_h, "tailspin blob frame h");
    t.assert(spin.frames, art_dims::tailspin_frames, "tailspin blob frames");
    t.assert(art_dims::tailspin_frame_w, 40, "tailspin frame w");
    t.assert(art_dims::tailspin_frame_h, 40, "tailspin frame h");
    t.assert(art_dims::tailspin_frames, 8, "tailspin frames");

    // Frame 0 is the east beast: dark tail on the left, white head on the
    // right, black ground shadow on the bottom row.
    t.assert(planeAtF(spin, 0, 0, 5, 20), 1, "frame0 dark tail plane0");
    t.assert(planeAtF(spin, 0, 1, 5, 20), 0, "frame0 dark tail dark only");
    t.assert(planeAtF(spin, 0, 0, 26, 16), 1, "frame0 white head plane0");
    t.assert(planeAtF(spin, 0, 1, 26, 16), 1, "frame0 white head plane1");
    t.assert(planeAtF(spin, 0, 2, 26, 16), 1, "frame0 white head plane2");
    t.assert(maskAtF(spin, 0, 6, 31), 1, "frame0 shadow opaque");
    t.assert(planeAtF(spin, 0, 0, 6, 31), 0, "frame0 shadow black eraser");

    // 4-shade quantization: LIGHT chest highlight keeps planes 0+1 only.
    t.assert(planeAtF(spin, 0, 0, 20, 15), 1, "frame0 light chest plane0");
    t.assert(planeAtF(spin, 0, 1, 20, 15), 1, "frame0 light chest plane1");
    t.assert(planeAtF(spin, 0, 2, 20, 15), 0, "frame0 light chest not white");

    // The white head orbits the body centre one 45-deg band per frame: right
    // (0), bottom-right (1), bottom (2), bottom-left (3), left (4), left-up (5),
    // top (6), top-right (7).
    auto whiteIn = [&](int frame, int x0, int y0, int x1, int y1) {
        int n = 0;
        for (int y = y0; y < y1; y++)
            for (int x = x0; x < x1; x++)
                n += planeAtF(spin, frame, 2, x, y);
        return n;
    };
    t.assert(whiteIn(0, 24, 0, 40, 40) > 0, 1, "frame0 head right");
    t.assert(whiteIn(0, 0, 0, 16, 40), 0, "frame0 no head left");
    t.assert(whiteIn(1, 24, 24, 40, 40) > 0, 1, "frame1 head bottom-right");
    t.assert(whiteIn(1, 0, 0, 16, 16), 0, "frame1 no head top-left");
    t.assert(whiteIn(2, 0, 24, 40, 40) > 0, 1, "frame2 head bottom");
    t.assert(whiteIn(2, 0, 0, 40, 16), 0, "frame2 no head top");
    t.assert(whiteIn(3, 0, 24, 16, 40) > 0, 1, "frame3 head bottom-left");
    t.assert(whiteIn(3, 24, 0, 40, 16), 0, "frame3 no head top-right");
    t.assert(whiteIn(4, 0, 0, 16, 40) > 0, 1, "frame4 head left");
    t.assert(whiteIn(4, 24, 0, 40, 40), 0, "frame4 no head right");
    t.assert(whiteIn(5, 0, 0, 16, 40) > 0, 1, "frame5 head left");
    t.assert(whiteIn(5, 24, 0, 40, 40), 0, "frame5 no head right");
    t.assert(whiteIn(6, 0, 0, 40, 16) > 0, 1, "frame6 head top");
    t.assert(whiteIn(6, 0, 24, 40, 40), 0, "frame6 no head bottom");
    t.assert(whiteIn(7, 16, 0, 40, 16) > 0, 1, "frame7 head top-right");
    t.assert(whiteIn(7, 0, 24, 16, 40), 0, "frame7 no head bottom-left");

    // Every frame differs (the rotation is observable), and opposite frames
    // (0 vs 4, 2 vs 6) differ too, so the sheet is not a mirrored flip.
    uint32_t hash[8];
    for (int i = 0; i < 8; i++)
        hash[i] = blobFrameHash(spin, i);
    for (int i = 0; i < 8; i++)
        for (int j = i + 1; j < 8; j++)
            t.assert(hash[i] != hash[j] ? 1 : 0, 1, "tailspin frames distinct");
    t.assert(hash[0] != hash[4] ? 1 : 0, 1, "east != west (upside down)");
}

void ArtDimsSuite(TestRunner &runner) {
    TestSuite suite("art dims");
    {
        Test t("core dims mirrored into art_dims.hpp");
        testCoreDimMirrors(t);
        suite.addTest(t);
    }
    {
        Test t("slash frames carry the core hit box");
        testSlashLayout(t);
        suite.addTest(t);
    }
    {
        Test t("overlay/effect sheets carry core-sized ink");
        testSheetPixels(t);
        suite.addTest(t);
    }
    {
        Test t("demo beast sheets read as distinct silhouettes");
        testMonsterSheets(t);
        suite.addTest(t);
    }
    {
        Test t("heavy tail overlay is a 24x16 mirror sheet");
        testHeavyTail(t);
        suite.addTest(t);
    }
    {
        Test t("chicken attack overlay is a 4-frame peck/leap mirror sheet");
        testChickenAttackSheet(t);
        suite.addTest(t);
    }
    {
        Test t("bull attack overlay is a 4-frame stomp/gore mirror sheet");
        testBullAttackSheet(t);
        suite.addTest(t);
    }
    {
        Test t("breakable-zone part overlays are 4-frame mirror sheets");
        testZonePartSheets(t);
        suite.addTest(t);
    }
    {
        Test t("heavy tail-spin overlay is a 24x24 world-direction sheet");
        testTailSpin(t);
        suite.addTest(t);
    }
    {
        Test t("heavy rotating spin sheet is 8 frames of 45-deg steps");
        testTailSpinSheet(t);
        suite.addTest(t);
    }
    {
        Test t("training-pole variant sheets carry distinct broken/flash art");
        testPoleSheets(t);
        suite.addTest(t);
    }
    runner.addTestSuite(suite);
}

}   // namespace artdimstest
